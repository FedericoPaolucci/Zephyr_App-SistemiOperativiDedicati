## CMakeLists.txt
```
cmake_minimum_required(VERSION 3.20.0)
find_package(Zephyr REQUIRED HINTS $ENV{ZEPHYR_BASE})
project(my_app)
zephyr_include_directories(${ZEPHYR_BASE}/../modules/lib/gui/lvgl)
target_sources(app PRIVATE
  src/main.c
  src/gui.c
  src/worker.c
  src/led_controller.c
  src/utils/monitor.c
)

target_include_directories(app PRIVATE include)
```

## prj.conf
```kconfig
# KERNEL CONFIG
CONFIG_MAIN_STACK_SIZE=4096
# ---
CONFIG_HEAP_MEM_POOL_SIZE=10240
CONFIG_MULTITHREADING=y
CONFIG_THREAD_NAME=y
CONFIG_PRINTK=y
CONFIG_LOG=y
CONFIG_GPIO=y
# ---

CONFIG_DISPLAY=y

CONFIG_LVGL=y
CONFIG_LV_Z_BITS_PER_PIXEL=16
CONFIG_LV_COLOR_16_SWAP=n
CONFIG_LV_Z_MEM_POOL_SIZE=8192

CONFIG_LV_CONF_MINIMAL=y
CONFIG_LV_USE_LABEL=y
CONFIG_LV_LABEL_TEXT_SELECTION=y
CONFIG_LV_LABEL_LONG_TXT_HINT=y
CONFIG_LV_USE_LINE=y
CONFIG_LV_USE_BUTTON=y

# TOUCH
CONFIG_INPUT=y
CONFIG_I2C=y
CONFIG_I2C_STM32=y
CONFIG_LV_Z_POINTER_INPUT=y
```

## src/main.c
```c
#include <zephyr/kernel.h>
#include "app.h"

// Dati e stack per i thread definiti globalmente
K_THREAD_STACK_DEFINE(gui_stack, CONFIG_MAIN_STACK_SIZE);      ///< Stack per il thread GUI
static struct k_thread gui_thread_data;                         ///< Dati del thread GUI

K_THREAD_STACK_DEFINE(worker_stack, CONFIG_MAIN_STACK_SIZE);   ///< Stack per il thread Worker
static struct k_thread worker_thread_data;                     ///< Dati del thread Worker

K_THREAD_STACK_DEFINE(worker_stack2, CONFIG_MAIN_STACK_SIZE);   ///< Stack per il thread Worker 2
static struct k_thread worker_thread_data2;                     ///< Dati del thread Worker 2

K_THREAD_STACK_DEFINE(led_controller_stack, CONFIG_MAIN_STACK_SIZE);   ///< Stack per il thread LED CONTROLLER
static struct k_thread led_controller_data;                     ///< Dati del thread LED CONTROLLER

// Coda per la comunicazione tra thread (max 10 messaggi, 4 byte per messaggio)
K_MSGQ_DEFINE(gui_msgq, sizeof(gui_command_t), 10, 4);          ///< Coda dei messaggi per la GUI

extern const k_tid_t init_tid;  ///< ID del thread di inizializzazione
struct k_mutex monitored_threads_mutex;  ///< Mutex per proteggere monitored_threads

/**
 * @brief Funzione del thread di inizializzazione.
 *
 * Questa funzione crea e registra i thread GUI e Worker, quindi termina il thread di inizializzazione.
 * Gestisce anche i messaggi di registrazione dei thread.
 */
void init_thread(void *arg1, void *arg2, void *arg3) {
    register_thread("INIT", init_tid);  ///< Registra il thread di inizializzazione
    k_mutex_init(&monitored_threads_mutex);  ///< Inizializza il mutex per monitoraggio threads

    // Crea il thread GUI
    k_tid_t gui_tid = k_thread_create(&gui_thread_data, gui_stack,
                                      K_THREAD_STACK_SIZEOF(gui_stack),
                                      gui_thread,
                                      NULL, NULL, NULL,
                                      GUI_PRIORITY, 0, K_NO_WAIT);
    register_thread("GUI", gui_tid);  ///< Registra il thread GUI

    k_sleep(K_SECONDS(2));  ///< Attende 2 secondi prima di creare il thread Worker

    // Crea il thread Worker
    k_tid_t worker_tid = k_thread_create(&worker_thread_data, worker_stack,
                                         K_THREAD_STACK_SIZEOF(worker_stack),
                                         worker_thread,
                                         "WORK_1", NULL, NULL,
                                         WORKER_PRIORITY, 0, K_NO_WAIT);
    register_thread("Worker", worker_tid);  ///< Registra il thread Worker
    
    k_sleep(K_SECONDS(2));  ///< Attende 2 secondi prima di creare il thread Worker 2
    
    // Crea il thread Worker 2
    k_tid_t worker_tid2 = k_thread_create(&worker_thread_data2, worker_stack2,
                                         K_THREAD_STACK_SIZEOF(worker_stack2),
                                         worker_thread,
                                         "WORK_2", NULL, NULL,
                                         WORKER_PRIORITY, 0, K_NO_WAIT);
    register_thread("Worker2", worker_tid2);  ///< Registra il thread Worker 2

    k_sleep(K_SECONDS(2));  ///< Attende 2 secondi prima di creare il thread LED CONTROLLER

    // Crea il thread led controller
    k_tid_t led_controller_tid = k_thread_create(&led_controller_data, led_controller_stack,
                                         K_THREAD_STACK_SIZEOF(led_controller_stack),
                                         led_controller_thread,
                                         NULL, NULL, NULL,
                                         LED_CTRL_PRIORITY, 0, K_NO_WAIT);
    register_thread("Led_ctrl", led_controller_tid);  ///< Registra il thread led controller

    k_sleep(K_SECONDS(2));  ///< Attende 2 secondi prima di terminare il thread di inizializzazione
    unregister_thread(init_tid);  ///< Deregistra il thread di inizializzazione

    // Termina il thread di inizializzazione
    k_thread_abort(k_current_get());  ///< Termina il thread corrente (init_thread)
}

// Creazione del thread di inizializzazione
K_THREAD_DEFINE(init_tid,
                CONFIG_MAIN_STACK_SIZE,
                init_thread,
                NULL, NULL, NULL,
                0, 0, 0);  ///< Definizione del thread di inizializzazione
```

## include/app.h
```c
#pragma once

#include <lvgl.h>
#include <zephyr/kernel.h>

// Costanti di configurazione per l'interfaccia grafica
#define RECT_HEIGHT     50  ///< Altezza del rettangolo nella GUI
#define RECT_SPACING    10  ///< Spaziatura tra i rettangoli nella GUI
#define GUI_PRIORITY    5   ///< Priorità del thread GUI
#define WORKER_PRIORITY 7   ///< Priorità del thread Worker
#define LED_CTRL_PRIORITY 7   ///< Priorità del thread LED_CONTROLLER
#define LED_ON_PRIORITY 8   ///< Priorità del thread LED_ON
#define LED_OFF_PRIORITY 8   ///< Priorità del thread LED_OFF
#define MAX_TASKS       20   ///< Numero massimo di task monitorabili
#define GUI_QUEUE_LEN   10  ///< Lunghezza della coda per i messaggi GUI
#define BUTTON_HEIGHT 40
#define BUTTON_SPACING 10

/** 
 * @brief Struttura per i thread monitorati.
 * Contiene nome, ID e label associata al thread.
 */
typedef struct {
    const char *name;      ///< Nome del thread
    k_tid_t tid;           ///< ID del thread
    lv_obj_t *label;       ///< Oggetto label nella GUI
} monitored_thread_t;

/**
 * @brief Tipi di comandi per la comunicazione con la GUI.
 */
typedef enum {
    GUI_CMD_REFRESH,       ///< Aggiorna la GUI
    GUI_CMD_WORKER_COUNT   ///< Aggiorna il contatore del worker
} gui_command_type_t;

/**
 * @brief Struttura del messaggio per i comandi della GUI.
 */
typedef struct {
    gui_command_type_t cmd;   ///< Tipo di comando
    k_tid_t tid;              ///< ID del thread da aggiornare
    const char *message;      ///< Messaggio da visualizzare nella label
} gui_command_t;

// Variabili esterne per la gestione dei thread e della comunicazione
extern struct k_msgq gui_msgq;           ///< Coda dei messaggi per il thread GUI
extern monitored_thread_t monitored_threads[MAX_TASKS]; ///< Array dei thread monitorati
extern int monitored_thread_count;       ///< Numero di thread monitorati
extern struct k_mutex gui_mutex;         ///< Mutex per la sincronizzazione della GUI
extern struct k_mutex monitored_threads_mutex;  ///< Mutex per proteggere monitored_threads

/** 
 * @brief Funzione del thread GUI.
 * Gestisce gli aggiornamenti della GUI in base ai messaggi ricevuti.
 */
void gui_thread(void *p1, void *p2, void *p3);

/** 
 * @brief Funzione del thread Worker.
 * Monitora i thread e aggiorna la GUI.
 */
void worker_thread(void *p1, void *p2, void *p3);

/** 
 * @brief Funzione del thread LED CONTROLLER.
 * Inizializza i threads per l'accensione/spegnimento dei LED
 */
void led_controller_thread(void *p1, void *p2, void *p3);

/**
 * @brief Registra un thread nel sistema di monitoraggio.
 * Aggiunge un thread alla lista monitorata e invia un comando di aggiornamento.
 */
void register_thread(const char *name, k_tid_t tid);

/**
 * @brief Deregistra un thread dal sistema di monitoraggio.
 * Rimuove un thread dalla lista monitorata e invia un comando di aggiornamento.
 */
void unregister_thread(k_tid_t tid);
```

## src/gui.c
```c
#include <zephyr/kernel.h>
#include <zephyr/drivers/display.h>
#include <zephyr/device.h>
#include <zephyr/input/input.h>
#include <lvgl.h>
#include <lvgl_input_device.h>
#include "app.h"

struct k_mutex gui_mutex;
static const int32_t sleep_time_ms = 50; // tempo di sleep del loop principale
void refreshGUI(lv_obj_t *scr, lv_style_t *rect_style);
void create_buttons(lv_obj_t *button_container, lv_style_t *rect_style);
static void btn_event_handler(lv_event_t * e);

// Thread GUI: inizializza il display e costruisce la schermata grafica
void gui_thread(void *p1, void *p2, void *p3) {
    const struct device *display;
    // const struct device *touch_dev;

    lv_style_t rect_style;

    display = DEVICE_DT_GET(DT_CHOSEN(zephyr_display)); // Ottiene il riferimento al dispositivo display dichiarato nel device tree.
    if (!device_is_ready(display)) { // Verifica che il dispositivo sia pronto
        printk("Error: display not ready\n");
        return;
    }
    
    k_mutex_init(&gui_mutex); // Inizializza mutex per accesso thread-safe a LVGL

    // Sfondo della schermata attiva
    lv_obj_t *scr = lv_scr_act();
    lv_obj_set_style_bg_color(lv_scr_act(), lv_color_hex(0x000000), 0); // Sfondo nero
    lv_obj_set_style_bg_opa(lv_scr_act(), LV_OPA_COVER, 0); // Imposta l’opacità totale (copertura completa dello sfondo).

    // contenitore per i thread (lo scrolling si attiva automaticamente se gli oggetti vanno fuori dallo schermo del contenitore)
    lv_obj_t *rect_container = lv_obj_create(scr);
    lv_obj_set_size(rect_container, LV_HOR_RES, LV_VER_RES - BUTTON_HEIGHT * 1.5 - RECT_SPACING * 2);
    lv_obj_align(rect_container, LV_ALIGN_TOP_MID, 0, 0);

    // contenitore per i pulsanti
    lv_obj_t *button_container = lv_obj_create(scr);
    lv_obj_set_size(button_container, LV_HOR_RES, BUTTON_HEIGHT * 1.5);
    lv_obj_align(button_container, LV_ALIGN_BOTTOM_MID, 0, -10);
    lv_obj_move_background(button_container);  // Porta il contenitore dei pulsanti sopra gli altri oggetti

    // stile del rettangolo
    lv_style_init(&rect_style);
    lv_style_set_bg_color(&rect_style, lv_color_hex(0x3333AA)); // colore sfondo
    lv_style_set_bg_opa(&rect_style, LV_OPA_COVER);              // opacità piena
    lv_style_set_radius(&rect_style, 4);                         // angoli arrotondati
    
    display_blanking_off(display); // Disattiva il “blanking” (schermata nera) del display, rendendo visibile il contenuto disegnato.
    
    // Crea i rettangoli per i thread monitorati
    refreshGUI(rect_container, &rect_style);

    // Crea i pulsanti nella parte inferiore
    create_buttons(button_container, &rect_style);

    while (1) {
        gui_command_t cmd;
        if (k_msgq_get(&gui_msgq, &cmd, K_NO_WAIT) == 0) {
            k_mutex_lock(&gui_mutex, K_FOREVER);
            switch (cmd.cmd) {
                case GUI_CMD_REFRESH:
                    refreshGUI(rect_container, &rect_style);
                    break;

                case GUI_CMD_WORKER_COUNT:
                    // Cerca il thread corrispondente e aggiorna la sua etichetta
                    k_mutex_lock(&monitored_threads_mutex, K_FOREVER);
                    for (int i = 0; i < monitored_thread_count; i++) {
                        if (monitored_threads[i].tid == cmd.tid) {
                            // Aggiorna l'etichetta con il messaggio ricevuto
                            lv_label_set_text(monitored_threads[i].label, cmd.message);
                            break;
                        }
                    }
                    k_mutex_unlock(&monitored_threads_mutex);  // Rilascia il mutex dopo l'operazione
                    break;
            }

            k_mutex_unlock(&gui_mutex);
        }
        lv_timer_handler(); // Mantiene attiva la GUI (aggiorna eventi, animazioni)
        k_msleep(sleep_time_ms); // sospende il thread corrente per il tempo indicato (50 ms).
    }
}

void refreshGUI(lv_obj_t *scr, lv_style_t *rect_style){
    // Crea o aggiorna i rettangoli
    lv_obj_clean(scr);
    for (int i = 0; i < monitored_thread_count; i++) {
        lv_obj_t *rect = lv_obj_create(scr); // Crea rettangolo per il thread
        lv_obj_set_size(rect, LV_HOR_RES - 20, RECT_HEIGHT);  // Larghezza quasi piena, altezza definita
        lv_obj_add_style(rect, rect_style, 0); // Applica lo stile
        lv_obj_align(rect, LV_ALIGN_TOP_MID, 0, i * (RECT_HEIGHT + RECT_SPACING) + 10); // Posizione dei rettangoli

        // Crea l'etichetta con il nome del thread
        lv_obj_t *label = lv_label_create(rect);  // Crea etichetta
        lv_label_set_text_fmt(label, "Thread: %s", monitored_threads[i].name); // Imposta il testo
        lv_obj_set_style_text_color(label, lv_color_white(), 0); // Imposta il colore del testo
        lv_obj_center(label); // Centra l'etichetta

        // Salva il riferimento al rettangolo (label)
        monitored_threads[i].label = label;
    }
}

// Funzione per creare i pulsanti
void create_buttons(lv_obj_t *button_container, lv_style_t *rect_style) {
    lv_obj_t *btn1 = lv_btn_create(button_container);
    lv_obj_set_size(btn1, LV_HOR_RES / 2 - 20, BUTTON_HEIGHT);
    lv_obj_add_style(btn1, rect_style, 0); // Applica lo stile
    lv_obj_align(btn1, LV_ALIGN_LEFT_MID, 10, 0);
    lv_obj_t *btn_label1 = lv_label_create(btn1);
    lv_label_set_text(btn_label1, "btn one");
    lv_obj_set_style_text_color(btn_label1, lv_color_white(), 0); // Imposta il colore del testo
    lv_obj_center(btn_label1);

    lv_obj_t *btn2 = lv_btn_create(button_container);
    lv_obj_set_size(btn2, LV_HOR_RES / 2 - 20, BUTTON_HEIGHT);
    lv_obj_add_style(btn2, rect_style, 0); // Applica lo stile
    lv_obj_align(btn2, LV_ALIGN_RIGHT_MID, -10, 0);
    lv_obj_t *btn_label2 = lv_label_create(btn2);
    lv_label_set_text(btn_label2, "btn two");
    lv_obj_set_style_text_color(btn_label2, lv_color_white(), 0); // Imposta il colore del testo
    lv_obj_center(btn_label2);

    // Associa l'evento di clic ai pulsanti
    lv_obj_add_event_cb(btn1, btn_event_handler, LV_EVENT_CLICKED, NULL);
    lv_obj_add_event_cb(btn2, btn_event_handler, LV_EVENT_CLICKED, NULL);
}

// Gestore degli eventi dei pulsanti
static void btn_event_handler(lv_event_t * e) {
    //lv_event_code_t code = lv_event_get_code(e);
    lv_obj_t *obj = lv_event_get_target_obj(e);

    // Ottieni il colore attuale di sfondo
    lv_color_t current_bg_color = lv_obj_get_style_bg_color(obj, LV_STATE_DEFAULT);

    // Cambia il colore di sfondo in base al colore corrente
    if (current_bg_color.red == 51 && current_bg_color.green == 51 && current_bg_color.blue == 170) {
        // Se il colore è blu (0x3333AA), cambia a rosso (0xFF0000)
        lv_obj_set_style_bg_color(obj, lv_color_hex(0xFF0000), LV_STATE_DEFAULT);
    } else {
        // Se il colore non è blu, cambia a rosso
        lv_obj_set_style_bg_color(obj, lv_color_hex(0x3333AA), LV_STATE_DEFAULT);
    }
}
```

## src/led_controller.c
```c
#include <zephyr/kernel.h>
#include <zephyr/drivers/gpio.h>
#include "app.h"

// Definizioni per il controllo del LED
#define LED0_NODE DT_ALIAS(led0)
static const struct gpio_dt_spec led = GPIO_DT_SPEC_GET(LED0_NODE, gpios);

// Semafori per la sincronizzazione dei thread
static struct k_sem sem_on;
static struct k_sem sem_off;

K_THREAD_STACK_DEFINE(led_on_stack, CONFIG_MAIN_STACK_SIZE);   ///< Stack per il thread ledon
static struct k_thread led_on_thread_data;                     ///< Dati del thread ledon

K_THREAD_STACK_DEFINE(led_off_stack, CONFIG_MAIN_STACK_SIZE);   ///< Stack per il thread ledoff
static struct k_thread led_off_thread_data;                     ///< Dati del thread ledoff

// Thread per accendere il LED
void led_on_thread(void *p1, void *p2, void *p3) {
    while (1) {
        k_sem_take(&sem_on, K_FOREVER);  // Attende che venga dato il semaforo per accendere
        gpio_pin_set(led.port, led.pin, 1);  // Accende il LED
        k_msleep(1000);  // Attendi 1 secondo
        k_sem_give(&sem_off);  // Dai il semaforo per spegnere il LED
    }
}

// Thread per spegnere il LED
void led_off_thread(void *p1, void *p2, void *p3) {
    while (1) {
        k_sem_take(&sem_off, K_FOREVER);  // Attende che venga dato il semaforo per spegnere
        gpio_pin_set(led.port, led.pin, 0);  // Spegne il LED
        k_msleep(1000);  // Attendi 1 secondo
        k_sem_give(&sem_on);  // Dai il semaforo per accendere il LED
    }
}

// Thread di controllo che avvia il ciclo di accensione/spegnimento
void led_controller_thread(void *p1, void *p2, void *p3) {
    // Configura il pin come output
    int ret = gpio_pin_configure(led.port, led.pin, GPIO_OUTPUT_ACTIVE);
    if (ret < 0) {
        unregister_thread(k_current_get());
        return;
    }

    // Inizializza i semafori
    k_sem_init(&sem_on, 0, 1);   // Semaforo per accendere il LED
    k_sem_init(&sem_off, 0, 1);  // Semaforo per spegnere il LED

    // Crea i thread
    k_tid_t led_on_tid = k_thread_create(&led_on_thread_data, led_on_stack, K_THREAD_STACK_SIZEOF(led_on_stack),
                    led_on_thread, NULL, NULL, NULL, LED_ON_PRIORITY, 0, K_NO_WAIT);
    register_thread("LED_ON", led_on_tid);  ///< Registra il thread LED ON

    k_tid_t led_off_tid = k_thread_create(&led_off_thread_data, led_off_stack, K_THREAD_STACK_SIZEOF(led_off_stack),
                    led_off_thread, NULL, NULL, NULL, LED_OFF_PRIORITY, 0, K_NO_WAIT);
    register_thread("LED_OFF", led_off_tid);  ///< Registra il thread LED OFF

    // Avvia il ciclo di accensione
    k_sem_give(&sem_on);  // Dai il semaforo per accendere il LED 

    k_sleep(K_SECONDS(2));
    unregister_thread(k_current_get());
    k_thread_abort(k_current_get());  ///< Termina il thread corrente
}
```

## src/worker.c
```c
#include <zephyr/kernel.h>
#include <lvgl.h>
#include <stdint.h>
#include <stdio.h>
#include "app.h"

#include <zephyr/drivers/gpio.h>

// Thread Worker: simula attività aggiornando le etichette dei task
void worker_thread(void *p1, void *p2, void *p3) {
    uint32_t counter = 0;
    gui_command_t msg;
    const char *worker_name = (const char *)p1;
    char formatted_message[50];
    while (1) {
        // Formatta il messaggio con snprintf
        if (formatted_message != NULL) {
            snprintf(formatted_message, sizeof(formatted_message), "Thread: %s, tick %u", worker_name, counter); // Formatta il messaggio

            // Prepara il messaggio
            msg.tid = k_current_get();
            msg.message = formatted_message;  // Assegna il messaggio formattato

            msg.cmd = GUI_CMD_WORKER_COUNT;  // Tipo di comando

            // Invia il messaggio al thread GUI
            k_msgq_put(&gui_msgq, &msg, K_NO_WAIT);
        }
        counter++;
        k_msleep(1000);  // Aspetta 1 secondo prima di inviare il prossimo aggiornamento
    }
}
```
